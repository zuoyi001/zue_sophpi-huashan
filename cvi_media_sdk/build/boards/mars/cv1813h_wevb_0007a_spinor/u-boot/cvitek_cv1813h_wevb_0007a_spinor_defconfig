## cvi_mmf_sdk/linux_5.10/drivers/efuse/Kconfig
```kconfig
# SPDX-License-Identifier: GPL-2.0-only
#
# Generic efuse drivers configuration
#

menuconfig EFUSE
	bool "Efuse drivers"
	default y
	help
		Efuse drivers offer a generic mechanism for
		efuse management.
		Only support mars and phobos currently
		Efuse driver build-in is better

if EFUSE

config MARS_EFUSE
	tristate "Efuse driver for CVITEK Mars"
	depends on ARCH_MARS || COMPILE_TEST
	default y
	help
		Select this driver for CVITEK mars efuse
		This driver is used for program and read efuse
		This driver can also be built as a module
		But build-in is better.

config PHOBOS_EFUSE
	tristate "Efuse driver for CVITEK Phobos"
	depends on ARCH_PHOBOS || COMPILE_TEST
	default y
	help
		Select this driver for CVITEK phobos efuse op
		This driver is used for program and read efuse
		This driver can also be built as a module
                But build-in is better.

endif
```

## cvi_mmf_sdk/u-boot-2021.10/board/cvitek/mars/Kconfig
```kconfig
if TARGET_CVITEK_MARS

choice
	prompt "Cvitek MARS verification platform type select"

config TARGET_CVITEK_MARS_ASIC
	bool "ASIC"
	help
	  This enables support for Cvitek's MARS SoC on ASIC platform.

	  If unsure, say N.

config TARGET_CVITEK_MARS_PALLADIUM
	bool "Palladium"
	help
	  This enables support for Cvitek's MARS SoC on PALLADIUM platform.

	  If unsure, say N.

config TARGET_CVITEK_MARS_FPGA
	bool "FPGA"
	help
	  This enables support for Cvitek's MARS SoC on FPGA platform.

	  If unsure, say N.

endchoice

config SYS_BOARD
	default "mars"

config SYS_VENDOR
	default "cvitek"

config SYS_CPU
	default "generic"

config SYS_CONFIG_NAME
	default "mars-asic" if TARGET_CVITEK_MARS_ASIC
	default "mars-palladium" if TARGET_CVITEK_MARS_PALLADIUM
	default "mars-fpga" if TARGET_CVITEK_MARS_FPGA

config CVITEK_SPI_FLASH
    bool
	prompt "Support CVITEK SPINOR"
    select SPI_FLASH
	select DM
	select DM_SPI
	select DM_SPI_FLASH
	select SPI_MEM
	select CMD_SF
    select CVI_SPIF

config ENV_SIZE
    default 0x10000 if ENV_IS_IN_SPI_FLASH
    default 0x20000 if ENV_IS_IN_MMC
	default 0x20000 if ENV_IS_IN_NAND

config ENV_SECT_SIZE
	default 0x10000 if ENV_IS_IN_SPI_FLASH
	default 0x40000 if ENV_IS_IN_MMC
	default 0x20000 if ENV_IS_IN_NAND

config ENV_OFFSET
    default 0x3A0000 if ENV_IS_IN_SPI_FLASH
    default 0x880000 if ENV_IS_IN_MMC
	default 0xae0000 if ENV_IS_IN_NAND

config ENV_OFFSET_REDUND
    default 0x3B0000 if ENV_IS_IN_SPI_FLASH
	default 0xb00000 if ENV_IS_IN_NAND

endif
```

## mmf-sdk/linux_5.10/arch/riscv/mach-cvitek/Kconfig
```kconfig
config ARCH_CVITEK
    bool "Cvitek SoC Family"
	select ION_CVITEK
	select SCHED_CVITEK
	help
      This enables support for Cvitek SoC family.

if ARCH_CVITEK
choice
	prompt "Select the chip of SoC"
	default ARCH_MARS
	help
	  Select the chip for SoC

config ARCH_MARS
	bool "Cvitek Mars SoC"
	help
	  This enables support for Cvitek's Mars

config ARCH_PHOBOS
	bool "Cvitek Phobos SoC"
	help
	  This enables support for Cvitek's Mars

endchoice

if ARCH_MARS
config ARCH_CVITEK_CHIP
	string "mars"
	help
	  This enables support for Cvitek Mars series

choice
	prompt "Select the platform of SoC"
	default ARCH_MARS_FPGA
	help
	  Select the platform of SoC
	    FPGA
	    PALLADIUM
	    ASIC

config ARCH_MARS_PALLADIUM
	bool "Cvitek Mars SoC - Palladium"
	help
	  This enables support for Cvitek's Mars SoC on Palladium platform

config ARCH_MARS_FPGA
	bool "Cvitek Mars SoC - FPGA"
	help
	  This enables support for Cvitek's Mars SoC on FPGA platform

config ARCH_MARS_ASIC
	bool "Cvitek Mars SoC- ASIC"
	help
	  This enables support for Cvitek's Mars SoC ASIC

endchoice
endif # end ARCH_MARS

if ARCH_PHOBOS
config ARCH_CVITEK_CHIP
	string "phobos"
	help
	  This enables support for Cvitek Phobos series

choice
	prompt "Select the platform of SoC"
	default ARCH_PHOBOS_FPGA
	help
	  Select the platform of SoC
	    FPGA
	    PALLADIUM
	    ASIC

config ARCH_PHOBOS_PALLADIUM
	bool "Cvitek Phobos SoC - Palladium"
	help
	  This enables support for Cvitek's Phobos SoC on Palladium platform

config ARCH_PHOBOS_FPGA
	bool "Cvitek Phobos SoC - FPGA"
	help
	  This enables support for Cvitek's Phobos SoC on FPGA platform

config ARCH_PHOBOS_ASIC
	bool "Cvitek Phobos SoC- ASIC"
	help
	  This enables support for Cvitek's Phobos SoC ASIC

endchoice
endif # end ARCH_MARS

endif # end ARCH_CVITEK
```

## product-sample/access-guard-turnkey/Kconfig
```kconfig
#
# For a description of the syntax of this configuration file,
# see Documentation/kbuild/kconfig-language.txt.
#
mainmenu "Smart-Access-Control Application"
##
config CUSTOMER
	prompt "Customer board."
	string
	default "cvitek"
	help
		Customer board define.
##
choice
    prompt "CVITEK CHIP"
    default CVI_SOC_CV183X
config CVI_SOC_CV183X
    bool "CV183X: cv1835"
config CVI_SOC_CV182X
    bool "CV182X: cv1821/cv1825"
config CVI_SOC_CR182X
    bool "CR182X: cr1825"
endchoice

config CVI_SOC
	string
	default "cv183x" if CVI_SOC_CV183X
	default "cv182x" if CVI_SOC_CV182X
	default "cr182x" if CVI_SOC_CV182X
##
choice
    prompt "Application Build."
    default APP_32BIT
config APP_32BIT
    bool "32bit Version."
config APP_64BIT
    bool "64bit Version."
config APP_UCLIBC
    bool "uclibc Version."
config APP_MUSL
    bool "musl Version."
endchoice

config MW_SDK_VER_LIB32
	bool
	default y if APP_32BIT
	help
		Depends MW SDK 32bit Version.

config MW_SDK_VER_LIB64
	bool
	default y if APP_64BIT
	help
		Depends on MW SDK 64bit Version.

config MW_SDK_VER_UCLIBC
	bool
	default y if APP_UCLIBC
	help
		Depends on MW SDK Uclibc Version.

config MW_SDK_VER_MUSL
	bool
	default y if APP_MUSL
	help
		Depends on MW SDK musl Version.
##
choice
    prompt "GUI engine"
    default ENABLE_GUI_LVGL
config ENABLE_GUI_LVGL
    bool "LittleVGL"
config ENABLE_GUI_AWTK
    bool "AWTK"
endchoice
##
choice
    prompt "Algorithm vendor"
	default ALGORITHM_VENDOR_AISDK
config ALGORITHM_VENDOR_AISDK
	bool "AiSdk"
config ALGORITHM_VENDOR_MEGVII
	bool "Megvii"
config ALGORITHM_VENDOR_SENSETIME
	bool "Sensetime"
endchoice

config ALGORITHM_VENDOR
	string
	default "aisdk" if ALGORITHM_VENDOR_AISDK
	default "megvii" if ALGORITHM_VENDOR_MEGVII
	default "sensetime" if ALGORITHM_VENDOR_SENSETIME
	help
		Facelib vendor define.
##
source "Kconfig.app"
source "customer/Kconfig"
source "function_lib/Kconfig"
##
config DEBUG_VER
	bool "Build application as DEBUG version"
	default n
	help
		DEBUG_VER define.
##
config STATIC_LINK
	bool "Build application with Static link"
	default n
	help
		Build application with Static link.
##
```

## product-sample/access-guard-turnkey/application_legacy/Kconfig
```kconfig
##
menu "Main app config"

config DUAL_SENSOR_SUPPORT
    bool "dual sensor (rgb+ir) support"
	default y
	help
        dual sensor (rgb+ir) support.

choice
    prompt "gui engine config"
    default ENABLE_GUI_LVGL
config ENABLE_GUI_LVGL
    bool "LittleVGL"
config ENABLE_GUI_AWTK
    bool "AWTK"
endchoice

choice
    prompt "vi rotation config"
    default VI_ROTATION_NONE
config VI_ROTATION_NONE
    bool "0 degree"
config VI_ROTATION_90
    bool "90 degree"
config VI_ROTATION_180
    bool "180 degree"
config VI_ROTATION_270
    bool "270 degree"
endchoice

choice
    prompt "vo rotation config"
    default VO_ROTATION_NONE
config VO_ROTATION_NONE
    bool "0 degree"
config VO_ROTATION_90
    bool "90 degree"
config VO_ROTATION_180
    bool "180 degree"
config VO_ROTATION_270
    bool "270 degree"
endchoice

config VPSS_VIDEO_FLIP_SUPPORT
    bool "vpss video flip support"
	default n
	help
        vpss video flip support.

config VPSS_VIDEO_MIRROR_SUPPORT
    bool "vpss video mirror support"
	default n
	help
        vpss video mirror support.

config VIDEO_RTSP_SUPPORT
    bool "Video rtsp support"
	default n
	help
        Video rtsp support.
choice
  	prompt "Video rtsp stream source"
    depends on VIDEO_RTSP_SUPPORT
    default VIDEO_RTSP_FROM_VPSS
config VIDEO_RTSP_FROM_VPSS
    bool "vpss grp/chn"
config VIDEO_RTSP_FROM_VI
    bool "vi chn"
endchoice

config ISP_FACE_AE_SUPPORT
    bool "isp face ae support"
    default n
	help
        isp face ae support.

config WEBSERVER_SUPPORT
    bool "webserver support"
	depends on !VIDEO_RTSP_SUPPORT
    default n
	help
        webserver support.

config FILE_STORAGE_SUPPORT
    bool "file storage support"
    default n
    help
        file storage support.

config FILE_PLAYER_SUPPORT
    bool "File player support"
    default n
	help
        File player support.

config FILE_PLAYER_SUPPORT
    bool "File player support"
    default n
	help
        File player support.


config ETHERNET_SUPPORT
    bool "Ethernet connect support"
    default n
	help
        Ethernet connect support.

config WIFI_SUPPORT
    bool "Wifi connect support"
    default n
	help
        Wifi connect support.

config BLUETOOTH_SUPPORT
    bool "Bluetooth connect support"
    default n
	help
        Bluetooth connect support.

config AUDIO_PLAYER_SUPPORT
    bool "Audio player support"
    default n
	help
        Audio player support.

config MP3_SUPPORT
    bool "Mp3 audio play support"
    depends on AUDIO_PLAYER_SUPPORT
    default n
	help
        Mp3 audio play support.

config FACTORY_TEST_SUPPORT
    bool "Factory test support"
    default y
	help
        Factory test support.

endmenu
```

## product-sample/access-guard-turnkey/cpsl/hal/screen/Kconfig
```kconfig
menu "Screen options"

choice
	prompt "Screen type"
	default CONFIG_SCREEN_HX8394

config SCREEN_HX8394
	bool "Enable screen HX8394"
	help
	  Say Y if you want to enable screen HX8394.

config SCREEN_OTA5182
	bool "Enable screen OTA5182"
	help
	  Say Y if you want to enable screen OTA5182.

config SCREEN_ST7796S
	bool "Enable screen ST7796S"
	help
	  Say Y if you want to enable screen ST7796S.

config SCREEN_ST7789
	bool "Enable screen ST7789"
	help
	  Say Y if you want to enable screen ST7789.

config SCREEN_ST7796S_RGB16BIT
	bool "Enable screen ST7796S_RGB16BIT"
	help
	  Say Y if you want to enable screen ST7796S_RGB16BIT.

config SCREEN_OTA7290B
	bool "Enable screen OTA7290B"
	help
	  Say Y if you want to enable screen OTA7290B.

config SCREEN_ILI8961
	bool "Enable screen ILI8961"
	help
	  Say Y if you want to enable screen ILI8961.

config SCREEN_OTA7290B_MIPI11INCH
	bool "Enable screen OTA7290B_MIPI11INCH"
	help
	  Say Y if you want to enable screen OTA7290B_MIPI11INCH.

config SCREEN_ICNL9707
	bool "Enable screen ICNL9707"
	help
	  Say Y if you want to enable screen ICNL9707.

endchoice

endmenu
```

## product-sample/access-guard-turnkey/cpsl/mmf/Kconfig
```kconfig
menu "Sensor options"

choice
	prompt "Sensor Dev 0"
	default SNS0_NONE
	config SNS0_NONE
		bool "none"
	config SNS0_NEXTCHIP_N5
		bool "nextchip_n5"
	config SNS0_OV_OS08A20
		bool "ov_os08a20"
	config SNS0_PICO_384
		bool "pico_384"
	config SNS0_PICO_640
		bool "pico_640"
	config SNS0_PIXELPLUS_PR2100
		bool "pixelplus_pr2100"
	config SNS0_SMS_SC200AI
		bool "sms_sc200ai"
	config SNS0_SMS_SC3335
		bool "sms_sc3335"
	config SNS0_SMS_SC4210
		bool "sms_sc4210"
	config SNS0_SMS_SC8238
		bool "sms_sc8238"
	config SNS0_SOI_F23
		bool "soi_f23"
	config SNS0_SOI_F35
		bool "soi_f35"
	config SNS0_SOI_H65
		bool "soi_h65"
	config SNS0_SONY_IMX290_2L
		bool "sony_imx290_2L"
	config SNS0_SONY_IMX307
		bool "sony_imx307"
	config SNS0_SONY_IMX307_2L
		bool "sony_imx307_2L"
	config SNS0_SONY_IMX307_SUBLVDS
		bool "sony_imx307_sublvds"
	config SNS0_SONY_IMX327
		bool "sony_imx327"
	config SNS0_SONY_IMX327_2L
		bool "sony_imx327_2L"
	config SNS0_SONY_IMX327_SUBLVDS
		bool "sony_imx327_sublvds"
	config SNS0_SONY_IMX334
		bool "sony_imx334"
	config SNS0_SONY_IMX335
		bool "sony_imx335"
	config SNS0_VIVO_MCS369
		bool "vivo_mcs369"
	config SNS0_VIVO_MCS369Q
		bool "vivo_mcs369q"
	config SNS0_VIVO_MM308M2
		bool "vivo_mm308m2"
	config SNS0_GCORE_GC2093
		bool "gcore_gc2093"
endchoice
choice
	prompt "Sensor Dev 1"
	default SNS1_NONE
	config SNS1_NONE
		bool "none"
	config SNS1_NEXTCHIP_N5
		bool "nextchip_n5"
		depends on (SNS0_NEXTCHIP_N5)
	config SNS1_SOI_F35_SLAVE
		bool "soi_f35_slave"
		depends on (SES0_SOI_F35)
	config SNS1_SONY_IMX307_SLAVE
		bool "sony_imx307_slave"
		depends on (SNS0_SONY_IMX307_2L)
	config SNS1_SONY_IMX327_SLAVE
		bool "sony_imx327_slave"
		depends on (SNS0_SONY_IMX327_2L)
	config SNS1_PIXELPLUS_PR2020
		bool "pixelplus_pr2020"
		depends on (SNS0_PIXELPLUS_PR2100 || SNS0_SONY_IMX335 || SNS0_GCORE_GC2093)
endchoice

endmenu
```

## product-sample/access-guard-turnkey/customer/Kconfig
```kconfig
##
menu "Customer app config"

config USE_DEFAULT_PQ_PARAM
    bool "use default pq param"
    default y
	help
        use default pq param.

config SDR_PQ_BIN_NAME
	depends on !USE_DEFAULT_PQ_PARAM
    string "ISP module SDR PQBIN name"
	default "/mnt/cfg/param/cvi_sdr_bin"
	help
        ISP module SDR PQBIN name.

config WDR_PQ_BIN_NAME
	depends on !USE_DEFAULT_PQ_PARAM
    string "ISP module WDR PQBIN name"
	default "/mnt/cfg/param/cvi_wdr_bin"
	help
        ISP module WDR PQBIN name.


config PANEL_DISPLAY_SUPPORT
    bool "Panel display support"
    default y
	help
        Panel display.

config PANEL_DISPLAY_HOR
	int "panel display horizon size."
    depends on PANEL_DISPLAY_SUPPORT
	default 720
	help
		panel display horizon size.

config PANEL_DISPLAY_VER
	int "panel display vertical size."
    depends on PANEL_DISPLAY_SUPPORT
	default 1280
	help
		panel display vertical size.

endmenu
```

## product-sample/access-guard-turnkey/function_lib/Kconfig
```kconfig
menu "Function libs config"

config ADVERTISEMENT_SUPPORT
	bool "advertisement support"
	default n
	help
	    advertisement support.
config AUDIO_SUPPORT
	bool "audio support"
	default y
	help
	    audio support.

config BOOTLOGO_SUPPORT
	bool "bootlogo support"
	default y
	help
	    bootlogo support.

config BLUETOOTH_SUPPORT
	bool "bluetooth support"
	default n
	help
	    bluetooth support.

config ETHERNET_SUPPORT
	bool "ethernet support"
	default y
	help
	    ethernet support.

config WIFI_SUPPORT
	bool "wifi support"
	default n
	help
	    wifi support.

config FINGERPRINT_SUPPORT
	bool "fingerprint support"
	default n
	help
	    fingerprint support.

config QRCODE_SUPPORT
	bool "qr_code support"
	default n
	help
	    qr_code support.

config DATABASE
	bool "database repo"
	default y
	help
	    database define.

config NFC_SUPPORT
	bool "nfc contol library"
	default y
	help
	    nfc contol library.
endmenu
```
