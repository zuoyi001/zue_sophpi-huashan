/dts-v1/;
#include "phobos_base_riscv.dtsi"
#include "phobos_asic_bga.dtsi"
#include "phobos_asic_spinor.dtsi"
#include "phobos_default_memmap.dtsi"

/ {

};

&sd {
	no-1-8-v;
	src-frequency = <25000000>;
	min-frequency = <400000>;
	max-frequency = <12000000>;
};
